## CMakeLists.txt
```
# Zephyr Workshop - 01_hello
# HAN University of Applied Sciences - Johan Korten - v1.0 2026
#
# A Zephyr application is a normal CMake project. find_package(Zephyr)
# pulls in the entire RTOS build; you only add your own sources to the
# `app` target that Zephyr defines.

cmake_minimum_required(VERSION 3.20.0)
find_package(Zephyr REQUIRED HINTS $ENV{ZEPHYR_BASE})
project(hello_workshop)

target_sources(app PRIVATE src/main.c)
```

## prj.conf
```kconfig
# Kconfig settings for this application.
# Empty is fine: the defaults already give us a console and printk.
# Compare with menuconfig: west build -t menuconfig
```

## src/main.c
```c
/*
 * 01_hello - Your first Zephyr application.
 *
 * Runs on the qemu_cortex_m3 board: an emulated ARM Cortex-M3, so
 * nobody needs hardware or a flasher today.
 *
 * Build and run (from this directory):
 *   west build -b qemu_cortex_m3
 *   west build -t run          (quit QEMU with Ctrl-A, then X)
 */

#include <zephyr/kernel.h>

int main(void)
{
    printk("Hello from Zephyr on board: %s\n", CONFIG_BOARD);

    while (1) {
        printk("uptime: %lld ms\n", k_uptime_get());
        k_msleep(1000);
    }

    return 0;
}
```
