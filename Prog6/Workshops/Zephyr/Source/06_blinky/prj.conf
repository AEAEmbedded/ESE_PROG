## CMakeLists.txt
```
# Zephyr Workshop - 06_blinky (real hardware!)
# HAN University of Applied Sciences - Johan Korten - v1.0 2026

cmake_minimum_required(VERSION 3.20.0)
find_package(Zephyr REQUIRED HINTS $ENV{ZEPHYR_BASE})
project(blinky_workshop)

target_sources(app PRIVATE src/main.c)
```

## prj.conf
```kconfig
# The GPIO driver is needed for the LED.
CONFIG_GPIO=y
```

## boards/rpi_pico2_rp2350a_m33.overlay
```dts
/*
 * Board overlay for the Raspberry Pi Pico 2 / Pico 2 W.
 * Zephyr applies this file automatically when you build for
 * rpi_pico2/rp2350a/m33 (file name = board name with / -> _).
 *
 * Why: on the Pico 2 W the onboard LED is wired to the WiFi chip,
 * not to a normal GPIO. So we give led0 a new meaning: an external
 * LED on pin GP15 (LED + resistor ~220 ohm to GND, breadboard).
 *
 * Note that main.c does not change AT ALL. That is the point of
 * devicetree: board differences live in data, not in your code.
 */

#include <zephyr/dt-bindings/gpio/gpio.h>

/ {
    leds {
        compatible = "gpio-leds";
        external_led: led_external {
            gpios = <&gpio0 15 GPIO_ACTIVE_HIGH>;
            label = "External LED on GP15";
        };
    };

    aliases {
        led0 = &external_led;
    };
};
```

## src/main.c
```c
/*
 * 06_blinky - The same code on REAL hardware.
 *
 * This app never names a pin number or a port address. It asks the
 * devicetree for "the LED known as led0" and the board's own .dts
 * (plus any overlay) decides what that is:
 *
 *   XIAO nRF52840: works out of the box - led0 is the red channel of
 *                  the onboard RGB LED (led1 = green, led2 = blue)
 *   Pico 2 (W):    see boards/rpi_pico2_rp2350a_m33.overlay - on the W
 *                  the onboard LED hangs off the WiFi chip, so we map
 *                  led0 to an external LED on a GPIO pin instead
 *
 * Build (pick your board):
 *   west build -p -b xiao_ble/nrf52840
 *   west build -p -b rpi_pico2/rp2350a/m33
 *
 * Flash (both boards have a UF2 bootloader, no tools needed):
 *   XIAO:    double-tap the reset button, then copy
 *            build/zephyr/zephyr.uf2 onto the XIAO drive
 *   Pico 2:  hold BOOTSEL while plugging in USB, then copy
 *            build/zephyr/zephyr.uf2 onto the RP2350 drive
 */

#include <zephyr/kernel.h>
#include <zephyr/drivers/gpio.h>

static const struct gpio_dt_spec led =
    GPIO_DT_SPEC_GET(DT_ALIAS(led0), gpios);

int main(void)
{
    if (!gpio_is_ready_dt(&led)) {
        printk("LED device not ready\n");
        return 0;
    }

    gpio_pin_configure_dt(&led, GPIO_OUTPUT_ACTIVE);

    while (1) {
        gpio_pin_toggle_dt(&led);
        printk("blink at %lld ms\n", k_uptime_get());
        k_msleep(500);
    }

    return 0;
}
```
